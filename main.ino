#include <Arduino.h>
#include <Wire.h>
#include <Adafruit_GFX.h>
#include <Adafruit_SSD1306.h>

// ---------- OLED ----------
#define SCREEN_WIDTH 128
#define SCREEN_HEIGHT 64
#define OLED_RESET -1
Adafruit_SSD1306 display(SCREEN_WIDTH, SCREEN_HEIGHT, &Wire, OLED_RESET);

// ---------- Buttons ----------
#define BTN_UP     32
#define BTN_DOWN   33
#define BTN_LEFT   25
#define BTN_RIGHT  26
#define BTN_SELECT 0

// ---------- Boot Logo ----------
// 'bruce_hd1', 128x64px
const unsigned char bootLogo[] PROGMEM = {
	0x00, 0x00, 0x00, 0x00, 0x00, 0x00, 0x0c, 0x00, 0x00, 0x00, 0x00, 0x00, 0x00, 0x00, 0x00, 0x00, 
	0x00, 0x00, 0x00, 0x00, 0x00, 0x00, 0x08, 0x00, 0x20, 0x00, 0x00, 0x00, 0x00, 0x00, 0x00, 0x00, 
	0x00, 0x00, 0x00, 0x00, 0x00, 0x00, 0x18, 0x00, 0x10, 0x00, 0x00, 0x00, 0x00, 0x00, 0x00, 0x00, 
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	0x00, 0x00, 0x00, 0x00, 0x00, 0x00, 0x00, 0x00, 0x00, 0x00, 0x00, 0x00, 0x00, 0x00, 0x00, 0x00
};

// Array of all bitmaps for convenience. (Total bytes used to store images in PROGMEM = 1040)
const int epd_bitmap_allArray_LEN = 1;
const unsigned char* epd_bitmap_allArray[1] = {
	bootLogo
};


// ---------- Menu Data ----------
// Main menu (Bruce firmware style)
const char* mainMenu[] = {"IR","WiFi","BLE","RF","OTHERS"};
const int mainCount = 5;

// IR Menu
const char* irMenu[] = {"TV-B-Gone","IR RX","Custom IR","Config"};
const int irCount = 4;

// IR -> TV-B-Gone -> Region Menu
const char* regionMenu[] = {"Region NA","Region EU"};
const int regionCount = 2;

// WiFi Menu
const char* wifiMenu[] = {"Connect","AP Mode","Disconnect","Attacks","Wardriving","Telnet","SSH","RAW Sniffer","TCP Client","TCP Listener","DPWO-ESP32","Evil Portal","Scan Hosts","WireGuard","Brucegotchi"};
const int wifiCount = 15;

// WiFi -> Attacks Submenu
const char* wifiAttackMenu[] = {"Beacon Spam","Target Attack","Deauth Flood"};
const int wifiAttackCount = 3;

// BLE Menu
const char* bleMenu[] = {"Scan","Bad BLE","BLE Keyboard","iOS Spam","Windows Spam","Samsung Spam","Android Spam","Spam All"};
const int bleCount = 8;

// RF Menu
const char* rfMenu[] = {"Scan / Copy","Custom RF","Spectrum","Jammer Full","Jammer Pulse","Config"};
const int rfCount = 6;

// RF -> Config
const char* rfConfigMenu[] = {"TX Pin","RX Pin","Module","Frequency"};
const int rfConfigCount = 4;

// Others Menu
const char* othersMenu[] = {"SD Manager","LittleFS","WebUI","GPS Logger","BadUSB","LED Control","OpenHaystack","iButton","Clicker","Interpreter","QR Code"};
const int othersCount = 11;

// -----------------------------
// MENU STATE
// -----------------------------
const char **currentMenu = mainMenu;
int currentCount = mainCount;

const char **parentMenu = nullptr;
int parentCount = 0;
bool parentIsMain = false;

int selectedIndex = 0;
int topIndex = 0;
bool isMainMenu = true;

const int visibleLines = 3;

// ---------- Button Handling ----------
bool readButton(int pin) {
  return digitalRead(pin) == LOW;
}

// ---------- Boot Logo ----------
void drawBootLogo() {
  display.clearDisplay();

  // 1️⃣ Small size first
  int wSmall = SCREEN_WIDTH / 4;
  int hSmall = SCREEN_HEIGHT / 4;
  display.drawBitmap((SCREEN_WIDTH - wSmall) / 2, (SCREEN_HEIGHT - hSmall) / 2,
                     bootLogo, wSmall, hSmall, SSD1306_WHITE);
  display.display();
  delay(300);

  // 2️⃣ Medium size
  display.clearDisplay();
  int wMed = SCREEN_WIDTH / 2;
  int hMed = SCREEN_HEIGHT / 2;
  display.drawBitmap((SCREEN_WIDTH - wMed) / 2, (SCREEN_HEIGHT - hMed) / 2,
                     bootLogo, wMed, hMed, SSD1306_WHITE);
  display.display();
  delay(300);

  // 3️⃣ Full size
  display.clearDisplay();
  display.drawBitmap(0, 0, bootLogo, SCREEN_WIDTH, SCREEN_HEIGHT, SSD1306_WHITE);
  display.display();
  delay(700);

  display.clearDisplay();
  display.display();
}

// ---------- Draw Horizontal Main Menu ----------
void drawMainMenu() {
  display.clearDisplay();
  display.setTextSize(1);
  display.setTextColor(SSD1306_WHITE);

  int arrowY = (SCREEN_HEIGHT / 2) - 3;
  display.setCursor(0, arrowY);
  display.print("<");
  display.setCursor(SCREEN_WIDTH - 6, arrowY);
  display.print(">");

  int textSize = 2;
  display.setTextSize(textSize);

  int16_t x1, y1;
  uint16_t w, h;
  display.getTextBounds(currentMenu[selectedIndex], 0, 0, &x1, &y1, &w, &h);

  while (w > (SCREEN_WIDTH - 10) && textSize > 1) {
    textSize--;
    display.setTextSize(textSize);
    display.getTextBounds(currentMenu[selectedIndex], 0, 0, &x1, &y1, &w, &h);
  }

  int xCenter = (SCREEN_WIDTH - w) / 2;
  int yCenter = (SCREEN_HEIGHT - h) / 2;

  display.setCursor(xCenter, yCenter);
  display.print(currentMenu[selectedIndex]);

  display.display();
}

// ---------- Draw Vertical Sub Menu ----------
void drawSubMenu() {
  display.clearDisplay();
  display.setTextSize(2);
  display.setTextColor(SSD1306_WHITE);

  int lineHeight = 16;
  int textAreaWidth = SCREEN_WIDTH - 8;

  for (int i = 0; i < visibleLines; i++) {
    int idx = topIndex + i;
    if (idx >= currentCount) break;

    int y = i * lineHeight;

    if (idx == selectedIndex) {
      display.fillRect(0, y, textAreaWidth, lineHeight, SSD1306_WHITE);
      display.setTextColor(SSD1306_BLACK);
    } else {
      display.setTextColor(SSD1306_WHITE);
    }

    display.setCursor(2, y);
    display.print(currentMenu[idx]);
  }

  // DOT SCROLLBAR
  int dotCount = currentCount;  
  int dotSize = 2;
  int dotSpacing = 6;
  int totalHeight = (dotCount - 1) * dotSpacing;
  int startY = (SCREEN_HEIGHT - totalHeight) / 2;
  int dotX = SCREEN_WIDTH - 4;

  for (int i = 0; i < dotCount; i++) {
    int dotY = startY + (i * dotSpacing);
    if (i == selectedIndex)
      display.fillCircle(dotX, dotY, dotSize + 1, SSD1306_WHITE);
    else
      display.drawCircle(dotX, dotY, dotSize, SSD1306_WHITE);
  }

  display.display();
}

// ---------- Menu Setter ----------
void setMenu(const char** menu, int count, bool main = false, const char** parent = nullptr, int pCount = 0, bool pMain = false) {
  currentMenu = menu;
  currentCount = count;
  selectedIndex = 0;
  topIndex = 0;
  isMainMenu = main;
  parentMenu = parent;
  parentCount = pCount;
  parentIsMain = pMain;
}

void setup() {
  Serial.begin(115200);

  if (!display.begin(SSD1306_SWITCHCAPVCC, 0x3C)) {
    Serial.println(F("SSD1306 allocation failed"));
    for (;;);
  }
  display.clearDisplay();
  display.display();

  // Show boot logo first
  drawBootLogo();

  pinMode(BTN_UP, INPUT_PULLUP);
  pinMode(BTN_DOWN, INPUT_PULLUP);
  pinMode(BTN_LEFT, INPUT_PULLUP);
  pinMode(BTN_RIGHT, INPUT_PULLUP);
  pinMode(BTN_SELECT, INPUT_PULLUP);

  setMenu(mainMenu, mainCount, true);
}

void loop() {
  if (isMainMenu) drawMainMenu();
  else drawSubMenu();

  // MAIN MENU Navigation
  if (isMainMenu) {
    if (readButton(BTN_LEFT)) {
      selectedIndex = (selectedIndex > 0) ? selectedIndex - 1 : currentCount - 1;
      delay(150);
    }
    if (readButton(BTN_RIGHT)) {
      selectedIndex = (selectedIndex < currentCount - 1) ? selectedIndex + 1 : 0;
      delay(150);
    }
  }
  // SUB MENU Navigation
  else {
    if (readButton(BTN_UP)) {
      if (selectedIndex > 0) selectedIndex--;
      if (selectedIndex < topIndex) topIndex--;
      delay(150);
    }
    if (readButton(BTN_DOWN)) {
      if (selectedIndex < currentCount - 1) selectedIndex++;
      if (selectedIndex > topIndex + visibleLines - 1) topIndex++;
      delay(150);
    }
    // LEFT = BACK
    if (readButton(BTN_LEFT)) {
      if (parentMenu != nullptr) {
        setMenu(parentMenu, parentCount, parentIsMain);
        delay(200);
        while (readButton(BTN_LEFT)) delay(10);
      }
    }
  }

  // SELECT Button Handling
  if (readButton(BTN_SELECT)) {
    if (currentMenu == mainMenu) {
      if (strcmp(currentMenu[selectedIndex], "IR") == 0) setMenu(irMenu, irCount, false, mainMenu, mainCount, true);
      else if (strcmp(currentMenu[selectedIndex], "WiFi") == 0) setMenu(wifiMenu, wifiCount, false, mainMenu, mainCount, true);
      else if (strcmp(currentMenu[selectedIndex], "BLE") == 0) setMenu(bleMenu, bleCount, false, mainMenu, mainCount, true);
      else if (strcmp(currentMenu[selectedIndex], "RF") == 0) setMenu(rfMenu, rfCount, false, mainMenu, mainCount, true);
      else if (strcmp(currentMenu[selectedIndex], "OTHERS") == 0) setMenu(othersMenu, othersCount, false, mainMenu, mainCount, true);
    }
    else if (currentMenu == irMenu) {
      if (strcmp(currentMenu[selectedIndex], "TV-B-Gone") == 0) setMenu(regionMenu, regionCount, false, irMenu, irCount, false);
    }
    else if (currentMenu == wifiMenu) {
      if (strcmp(currentMenu[selectedIndex], "Attacks") == 0) setMenu(wifiAttackMenu, wifiAttackCount, false, wifiMenu, wifiCount, false);
    }
    else if (currentMenu == rfMenu) {
      if (strcmp(currentMenu[selectedIndex], "Config") == 0) setMenu(rfConfigMenu, rfConfigCount, false, rfMenu, rfCount, false);
    }
    delay(200);
  }
}
